## conf/bblayers.conf.sample
```bitbake
# POKY_BBLAYERS_CONF_VERSION is increased each time build/conf/bblayers.conf
# changes incompatibly
POKY_BBLAYERS_CONF_VERSION = "1"

BBPATH = "${TOPDIR}"
BBFILES ?= ""

BBLAYERS ?= " \
  ##OEROOT##/meta \
  ##OEROOT##/meta-poky \
  ##OEROOT##/meta-yocto-bsp \
  ##OEROOT##/../meta-openembedded/oe \
  ##OEROOT##/../meta-openembedded/meta-networking \
  ##OEROOT##/../meta-openembedded/meta-multimedia \
  ##OEROOT##/../meta-openembedded/meta-filesystems \
  ##OEROOT##/../meta-openembedded/meta-python \
  ##OEROOT##/../meta-kodi \
  ##OEROOT##/../meta-meson \
  ##OEROOT##/../meta-ugoos \
  "
```

## conf/machine/include/ugoos-am6-s922x-dtb.inc
```bitbake
KERNEL_DEVICETREE:ugoos-am6 += "amlogic/meson-g12b-ugoos-am6.dtb"
IMAGE_BOOT_FILES:append:ugoos-am6 = " meson-g12b-ugoos-am6.dtb:meson-g12b-ugoos-am6.dtb"
```

## conf/machine/ugoos-am6.conf
```bitbake
# Ugoos am6 board

require conf/machine/include/amlogic-s922x.inc
require conf/machine/include/ugoos-am6-s922x-dtb.inc
require conf/machine/include/amlogic-legacy-boot.inc

KERNEL_IMAGETYPE:ugoos-am6 = "uImage"
#KERNEL_CLASS:ugoos-am6 = "kernel-uimage-meson"
#IMAGE_CLASSES:ugoos-am6 += "image_types_meson"
#
#EXTRA_IMAGEDEPENDS += "s905-autoscript s905-autoscript-multiboot"

IMAGE_BOOT_FILES:append:ugoos-am6 = " uImage "
IMAGE_BOOT_FILES:append:ugoos-am6 =  " s905_autoscript aml_autoscript aml_autoscript.zip "

MACHINE_FEATURES:append:ugoos-am6 = " bluetooth rtc keyboard usbhost usbgadget wifi"
MACHINE_FEATURES:remove:ugoos-am6 = "qemu-usermode"
#IMAGE_BOOT_FILES:append = " Image "

PREFERRED_PROVIDER_amlogic-fip = ""
PREFERRED_PROVIDER_virtual/bootloader = ""
PREFERRED_PROVIDER_u-boot = ""
PREFERRED_VERSION_u-boot-meson-gx = ""
PREFERRED_PROVIDER_virtual/kernel = "linux-meson64"
PREFERRED_VERSION_fmt = "8.0.1"

SERIAL_CONSOLES="115200;ttyAML0"

UBOOT_MACHINE = "odroid-n2_config"
UBOOT_EXTLINUX = "1"
# Boot on SDCard
UBOOT_EXTLINUX_ROOT:ugoos-am6 = "root=/dev/mmcblk1p1"
UBOOT_EXTLINUX_FDT:ugoos-am6 = "../meson-gxbb-odroidn2.dtb"
UBOOT_EXTLINUX_CONSOLE:ugoos-am6 = "console=ttyAML0"

MACHINE_ESSENTIAL_EXTRA_RDEPENDS:ugoos-am6 += " \
       kernel-image \
       kernel-devicetree \
"

WIC_COMMAND:ugoos-am6 = "wic_command_meson_gxbb"
# Generate an SDCard Image

WKS_FILE:ugoos-am6 = "sdimage-bootpart-ugoos.wks"
```
